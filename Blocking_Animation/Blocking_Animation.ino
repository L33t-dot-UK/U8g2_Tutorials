#include <U8g2lib.h>

U8G2_SH1106_128X64_NONAME_F_HW_I2C auxScreen(U8G2_R0);

const int sizeBytes = 376;
const int frames = 4;

static unsigned char icon[frames][sizeBytes] = {
   0x00, 0x00, 0x00, 0x00, 0x00, 0x00, 0x00, 0x00, 0x00, 0x00, 0x00, 0x00,
   0x00, 0x00, 0x00, 0x00, 0x00, 0x00, 0x00, 0x00, 0x00, 0x00, 0x00, 0x00,
   0x00, 0x00, 0x00, 0x00, 0x00, 0x00, 0x00, 0x00, 0x00, 0x00, 0x00, 0xf0,
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   0x40, 0x00, 0x00, 0x00 };

//BLOCKING FUNCTION
                //  WIDTH         HEIGHT      FRAME DELAY   X INC            Y INC         START X POS     END X POS    START Y POS   END Y POS   NO FRAMES    SIZE OF EACH FRAME            ICON
void playAnimation(int _width, int _height, int fDelay, int xIncrement, int yIncrement, int startXpos, int endXpos, int startYpos, int endYpos, int _frames, int _sizeBytes, unsigned char _icon[frames][sizeBytes])
{
    int xPos = startXpos;
    int yPos = startYpos;

    boolean toLoop = true;
    boolean lefttoRight = true;
    boolean upToDown = true;

    boolean XtoLoop = true;
    boolean YtoLoop = true;

    while (toLoop)
    {
        //draw animation on screen
        //unsigned char tmp_Icon[_sizeBytes]; //NO NEED FOR THIS CHARACTER ARRAY
        
        for(int i = 0; i < _frames; i++)
        {
            if((startXpos - endXpos) < 0)
            {
                //moving left to right
                lefttoRight = true;
                if(xPos<endXpos)
                {
                    XtoLoop = true;
                }
                else
                {
                    XtoLoop = false;
                }
            }
            else
            {
                //right to left
                lefttoRight = false;
                if(xPos > endXpos)
                {
                    XtoLoop = true;
                }
                else
                {
                    XtoLoop = false;
                }
            }
            
            if((startYpos - endYpos) < 0)
            {
                //moving Up to down
                upToDown = true;
                if(yPos<endYpos)
                {
                    YtoLoop = true;
                }
                else
                {
                    YtoLoop = false;
                }
            }
            else
            {
                //Moving from bottom to top
                upToDown = false;
                if(yPos > endYpos)
                {
                    YtoLoop = true;
                }
                else
                {
                    YtoLoop = false;
                }
            }


            /* THIS CODE HAS BEEN REPLACED WITH WHAT YOU CAN SEE ON LINE 239, NO NEED TO COPY THE ARRAY
            for(int ii = 0; ii < _sizeBytes; ii++)
            {
                tmp_Icon[ii] = _icon[i][ii];
            }
            */
            
            delay(fDelay);

            if(XtoLoop == true)
            {
                if(lefttoRight == true){xPos = xPos + xIncrement;}
                else {xPos = xPos - xIncrement;}
            }

            if(YtoLoop == true)
            {
                if(upToDown == true){yPos = yPos + yIncrement;}
                else {yPos = yPos - yIncrement;}
            }
            
            //auxScreen.drawXBM(xPos, yPos, _width, _height, tmp_Icon); //REPLACED WITH THE BELOW LINE OF CODE
            auxScreen.drawXBM(xPos, yPos, _width, _height, _icon[i]);
            auxScreen.sendBuffer();
            auxScreen.clearBuffer();

            if(XtoLoop == false && YtoLoop == false)
            {
                toLoop = false;
            }
        }
    }
}


void setup() {
    // put your setup code here, to run once:
    auxScreen.begin();
    Serial.begin(9600);
}

void loop() {
    // put your main code here, to run repeatedly:
    playAnimation (64,47,50,6,3,-64,128,-40,64,frames,sizeBytes, icon);
    
}
